## lib/cmis/Kconfig
```kconfig
# Copyright The Zephyr Project Contributors
#
# SPDX-License-Identifier: Apache-2.0

config CMIS
	bool "CMIS pluggable module management decoding"
	help
	  Enable decoding of the Common Management Interface Specification
	  (CMIS) management memory used by high-speed pluggable transceivers
	  such as QSFP-DD, OSFP, SFP-DD and DSFP: the module-level monitors in
	  Lower Memory, the administrative information in Upper Page 00h, the
	  monitor thresholds in Page 02h and the lane status in Page 11h.
```
